## Kconfig
```kconfig
config ZMK_BEHAVIOR_ALT_REPEAT
    bool
    default y

config ZMK_BEHAVIOR_FLOW_KEY
    bool
    default y

config ZMK_BEHAVIOR_DEAD_KEY
    bool
    default y
    depends on DT_HAS_ZMK_BEHAVIOR_DEAD_KEY_ENABLED
```

## boards/arm/quacken_v0/Kconfig.defconfig
```kconfig
if BOARD_QUACKEN_V0
    config ZMK_KEYBOARD_NAME
        default "Quacken V0"

    # XXX: We’re using a W25Q128JVS, but it doesn’t have a RP2_FLASH definition.
    config RP2_FLASH_W25Q080
        default y
endif
```

## boards/arm/quacken_v0/dts/bindings/nxp,pcal6524.yaml
```yaml
# This is a back-port of the PCAL6524 driver from Zephyr 4.
#
# Copyright 2024 NXP
# SPDX-License-Identifier: Apache-2.0
description: NXP PCAL6524 I2C GPIO expander node
compatible: nxp,pcal6524
include: nxp,pca_series.yaml

properties:
  ngpios:
    required: true
    const: 24
```

## boards/ergonautes/quacken_flex/Kconfig.quacken_flex
```kconfig
# SPDX-License-Identifier: Apache-2.0

config BOARD_QUACKEN_FLEX
    select SOC_RP2040
    select ZMK_BOARD_COMPAT
    imply RETAINED_MEM
    imply RETENTION
    imply RETENTION_BOOT_MODE
```

## boards/ergonautes/quacken_flex/quacken_flex_defconfig
```kconfig
CONFIG_CLOCK_CONTROL=y
CONFIG_SYS_CLOCK_HW_CYCLES_PER_SEC=125000000

# Enable USB CDC ACM logging for debugging
# CONFIG_ZMK_USB_LOGGING=y

# Enable reset by default
CONFIG_RESET=y

# Code partition needed to target the correct flash range
CONFIG_USE_DT_CODE_PARTITION=y

# Output UF2 by default, native bootloader supports it.
CONFIG_BUILD_OUTPUT_UF2=y

CONFIG_ZMK_USB=y

# I2C key scan
CONFIG_I2C=y
CONFIG_GPIO=y
CONFIG_PINCTRL=y
CONFIG_GPIO_PCA_SERIES=y
CONFIG_ZMK_KSCAN_DIRECT_POLLING=y

# Rotary encoder support
CONFIG_EC11=y
CONFIG_EC11_TRIGGER_GLOBAL_THREAD=y

# CONFIG_LOG_PROCESS_THREAD_STARTUP_DELAY_MS=3000
```

## boards/ergonautes/quacken_v0/Kconfig.defconfig
```kconfig
if BOARD_QUACKEN_V0
    config ZMK_KEYBOARD_NAME
        default "Quacken V0"

    config RP2_FLASH_W25Q080
        default y
endif
```

## boards/shields/quacken_zero/Kconfig.defconfig
```kconfig
if SHIELD_QUACKEN_ZERO

# Name must be less than 16 characters long!
config ZMK_KEYBOARD_NAME
    default "Quacken Zero"

endif
```

## dts/bindings/behaviors/alt-repeat.yaml
```yaml
description: >
  Alt-Repeat Behavior
  Repeat the previous keycode unless when specified

compatible: "zmk,behavior-alt-repeat"

include: zero_param.yaml

properties:
  usage-pages:
    type: array
    required: true
```

## dts/bindings/behaviors/dead-key.yaml
```yaml
compatible: "zmk,behavior-dead-key"

description: >
  Dead Key Behavior
  prefix a key press with an unshifted-keycode, to more easilly and reliably
  use dead keys on the host layout to write more complex symbols.

include: one_param.yaml

properties:
  dead-key:
    type: int
    required: true
```

## dts/bindings/behaviors/flow-key.yaml
```yaml
description: >
  Flow-key Behavior
  Substitute a behavior depending on the previously tapped behavior

compatible: "zmk,behavior-flow-key"

include: zero_param.yaml

properties:
  timeout-ms:
    type: int
    default: 0
  bindings:
    type: phandle-array
    required: true
```

## dts/bindings/behaviors/mod-hold.yaml
```yaml
description: >
  Mod-hold Behavior
  Wraps a behavior while holding a selection of behaviors during it.
  Handy when combined with home row mods.

compatible: "zmk,behavior-mod-hold"

include: two_param.yaml

properties:
  binding:
    type: phandle
    required: true
  mods-to-hold:
    type: int
    required: true
```

## dts/bindings/gpio/nxp,pcal6524.yaml
```yaml
# This is a back-port of the PCAL6524 driver from Zephyr 4.
#
# Copyright 2024 NXP
# SPDX-License-Identifier: Apache-2.0

description: NXP PCAL6524 I2C GPIO expander node
compatible: nxp,pcal6524
include: [gpio-controller.yaml, i2c-device.yaml]

properties:
  reset-gpios:
    type: phandle-array
    description:
      Reset GPIO pin (active-low)
      Left blank if the device does not have reset pin
      or the pin is not connected in your application.

  int-gpios:
    type: phandle-array
    description:
      Interrupt GPIO pin (active-low open-drain)
      Left blank if the pin is not connected in your
      application.

  "#gpio-cells":
    const: 2

  ngpios:
    required: true
    const: 24

gpio-cells:
  - pin
  - flags
```
