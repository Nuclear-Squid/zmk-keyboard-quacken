/ {
  macros {
    kpc: circumflex {
      compatible = "zmk,behavior-macro-one-param";
      #binding-cells = <1>;
      tap-ms = <0>;
      wait-ms = <0>;
      bindings
        = <&macro_tap &kp LBKT>
        , <&macro_pause_for_release>
        , <&macro_param_1to1>
        , <&kp MACRO_PLACEHOLDER>
        ;
    };
    spc: space_after_dk {
      compatible = "zmk,behavior-macro-one-param";
      #binding-cells = <1>;
      tap-ms = <0>;
      wait-ms = <0>;
      bindings
        = <&macro_param_1to1>
        , <&kp MACRO_PLACEHOLDER>
        , <&macro_pause_for_release>
        , <&macro_tap &kp SPACE>
        ;
    };
  };
};
