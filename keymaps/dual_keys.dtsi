#include "timing.dtsi"

// clang-format off

#define NO_DUAL_KEYS  1
#define LAYER_TAPS    2
#define HOME_ROW_MODS 3

#ifndef DUAL_KEYS
  #define DUAL_KEYS HOME_ROW_MODS
#endif

/**
 * Home-Row Mods
 */

#if DUAL_KEYS == HOME_ROW_MODS
  #define HRM_S &hrm LGUI S
  #define HRM_D &hrm LCTL D
  #define HRM_F &hrm LALT F
  #define HRM_J &hrm LALT J
  #define HRM_K &hrm RCTL K
  #define HRM_L &hrm RGUI L
#else
  #define HRM_S &kp S
  #define HRM_D &kp D
  #define HRM_F &kp F
  #define HRM_J &kp J
  #define HRM_K &kp K
  #define HRM_L &kp L
#endif

#ifdef HRM_SHIFT
  #define HRM_A    &hrm LSHIFT A
  #define HRM_SEMI &hrm RSHIFT SEMI
#else
  #define HRM_A    &kp A
  #define HRM_SEMI &kp SEMI
#endif

/**
 * Thumb keys
 */

#ifdef VIM_NAVIGATION
  #define CHOSEN_NAV_LAYER VIM_NAV_LAYER
  #define CHOSEN_NUM_LAYER NUM_ROW_LAYER
  #define CHOSEN_HRM_LAYER NUM_ROW_LAYER
#else
  #define CHOSEN_NAV_LAYER NUM_NAV_LAYER
  #define CHOSEN_NUM_LAYER NUM_NAV_LAYER
  #define CHOSEN_HRM_LAYER FUNCTION_LAYER
#endif

#ifdef LEFT_HAND_SPACE
  #define LEFT_THUMB_LT   &hrm LCTL SPACE
  #define RIGHT_THUMB_LT  &magic_backspace
  #define LEFT_THUMB_HRM  &lt CHOSEN_NAV_LAYER SPACE
  #define RIGHT_THUMB_HRM &magic_backspace
#else
  #define LEFT_THUMB_LT   &mt LCTL BACKSPACE
  #define RIGHT_THUMB_LT  &lt CHOSEN_NAV_LAYER SPACE
  #define LEFT_THUMB_HRM  &sc CHOSEN_NAV_LAYER BACKSPACE
  #define RIGHT_THUMB_HRM &lt CHOSEN_NAV_LAYER SPACE
#endif

#if DUAL_KEYS == NO_DUAL_KEYS
  #define LEFT_THUMB_TUCK    &kp LALT
  #define LEFT_THUMB_HOME    &kp LCTL
  #define LEFT_THUMB_REACH   &kp LGUI
  #define RIGHT_THUMB_REACH  &mo CHOSEN_NAV_LAYER
  #define RIGHT_THUMB_HOME   &kp SPACE
  #define RIGHT_THUMB_TUCK   &mo SYMBOLS_LAYER
#elif DUAL_KEYS == LAYER_TAPS
  #define LEFT_THUMB_TUCK    &EZ_SK(LSHIFT)
  #define LEFT_THUMB_HOME    LEFT_THUMB_LT
  #define LEFT_THUMB_REACH   &mt LGUI TAB
  #define RIGHT_THUMB_REACH  &mt LALT ENTER
  #define RIGHT_THUMB_HOME   RIGHT_THUMB_LT
  #define RIGHT_THUMB_TUCK   &EZ_SL(SYMBOLS_LAYER)
#elif DUAL_KEYS == HOME_ROW_MODS
  #define LEFT_THUMB_TUCK    &EZ_SK(LSHIFT)
  #define LEFT_THUMB_HOME    LEFT_THUMB_HRM
  #define LEFT_THUMB_REACH   &sc CHOSEN_HRM_LAYER TAB
  #define RIGHT_THUMB_REACH  &sc CHOSEN_HRM_LAYER ENTER
  #define RIGHT_THUMB_HOME   RIGHT_THUMB_HRM
  #define RIGHT_THUMB_TUCK   &EZ_SL(SYMBOLS_LAYER)
#endif


/ {
  behaviors {
    magic_backspace: magic_backspace {
      compatible = "zmk,behavior-mod-morph";
      #binding-cells = <0>;
      bindings = <&sc NUM_NAV_LAYER BACKSPACE>, <&lt NUM_NAV_LAYER SPACE>;
      mods = <MOD_LSFT>;
      keep-mods = <MOD_LSFT>;
    };

    magic_backspace_vim: magic_backspace_vim {
      compatible = "zmk,behavior-mod-morph";
      #binding-cells = <0>;
      bindings = <&sc VIM_NAV_LAYER BACKSPACE>, <&lt VIM_NAV_LAYER SPACE>;
      mods = <MOD_LSFT>;
      keep-mods = <MOD_LSFT>;
    };
  };
};
