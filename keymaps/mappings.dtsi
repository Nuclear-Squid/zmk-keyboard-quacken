#include <behaviors.dtsi>
#include <dt-bindings/zmk/keys.h>

// Define a two-level key (e.g. punctuation key)
#define TWO_LEVEL_KEY(name, base, shift) name: name { \
  compatible = "zmk,behavior-mod-morph";              \
  #binding-cells = <0>;                               \
  bindings = <base>, <shift>;                         \
  mods = <(MOD_LSFT|MOD_RSFT)>;                       \
};

/ {
  macros {
    digraph: digraph {
      compatible = "zmk,behavior-macro-two-param";
      #binding-cells = <2>;
      tap-ms = <0>;
      wait-ms = <0>;
      bindings = <
        &macro_param_1to1 &kp MACRO_PLACEHOLDER
        &macro_param_2to1 &kp MACRO_PLACEHOLDER>;
    };
  };
};
