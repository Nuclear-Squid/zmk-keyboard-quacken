#include <behaviors.dtsi>
#include <dt-bindings/zmk/keys.h>
#include <dt-bindings/zmk/pointing.h>
#define ZMK_POINTING_DEFAULT_SCRL_VAL 72

/ {
	behaviors {
        mouse_scroll_v: mouse_scroll_v {
            compatible = "zmk,behavior-sensor-rotate";
            label = "MOUSE_SCRLL_V";
            #sensor-binding-cells = <0>;
            bindings = <&msc SCRL_UP>, <&msc SCRL_DOWN>;
            tap-ms = <20>;
        };

        mouse_scroll_h: mouse_scroll_h {
            compatible = "zmk,behavior-sensor-rotate";
            label = "MOUSE_SCROLL_H";
            #sensor-binding-cells = <0>;
            bindings = <&msc SCRL_LEFT>, <&msc SCRL_RIGHT>;
            tap-ms = <20>;
				};
	};
};
